## config/boards/arm/bakeneko60_go/Kconfig
```kconfig
# Copyright (c) 2023 Andrew Kannan
# SPDX-License-Identifier: MIT

config BOARD_ENABLE_DCDC
    bool "Enable DCDC mode"
    select SOC_DCDC_NRF52X
    default y
    depends on BOARD_BAKENEKO60_GO
```

## config/boards/arm/bakeneko60_go/Kconfig.board
```kconfig
# Copyright (c) 2023 Andrew Kannan
# SPDX-License-Identifier: MIT

config BOARD_BAKENEKO60_GO
    bool "bakeneko60_go"
    depends on SOC_NRF52840_QIAA
```
